## modules/dts/bindings/sensor/st,lsm6ds3-i2c.yaml
```yaml
# SPDX-License-Identifier: Apache-2.0

description: STMicroelectronics LSM6DS3 6-axis accelerometer and gyrometer

compatible: "st,lsm6ds3"

include: i2c-device.yaml

properties:
    irq-gpios:
      # This signal is active high when produced by the sensor
      type: phandle-array
      required: false
```
